## sdkconfig.defaults
```kconfig
CONFIG_FREERTOS_HZ=1000
CONFIG_ARDUINO_USB_MODE=0
CONFIG_ARDUINO_USB_CDC_ON_BOOT=1

CONFIG_USJ_ENABLE_USB_SERIAL_JTAG=n

# Use TinyUSB for USB OTG CDC
CONFIG_TINYUSB=y
CONFIG_TINYUSB_ENABLED=y
CONFIG_TINYUSB_CDC_ENABLED=y
CONFIG_TINYUSB_CDC_COUNT=1
```
